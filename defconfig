## defconfig
```kconfig
# Example iw build time configuration
#
# This file lists the configuration options that are used when building the
# iw binary. All lines starting with # are ignored. Configuration option
# lines must be commented out completely, if they are not to be included,
# i.e. just setting VARIABLE=n is not disabling that variable.
#
# This file is included in Makefile, so variables like CFLAGS and LIBS can also
# be modified from here. In most cases, these lines should use += in order not
# to override previous values of the variables.

# LibNL location
# (if not installed in a way that makes the compiler/linker find it)
# by default, libnl's 'make install' installs to /usr/local/ so you may
# need this
#
# CONFIG_LIBNL_LOC = /usr/local/
# CFLAGS += -I$(CONFIG_LIBNL_LOC)/include
# LDFLAGS += -L$(CONFIG_LIBNL_LOC)/lib
```
